## config/west.yml
```yaml
manifest:
  remotes:
    - name: zmkfirmware
      url-base: https://github.com/zmkfirmware
    - name: mentako-ya
      url-base: https://github.com/mentako-ya
  projects:
    - name: zmk
      remote: zmkfirmware
      revision: abb64ba316c29caddc49727ca2cac2f0ed5970c7
      import: app/west.yml
    - name: zmk-pmw3610-driver
      remote: mentako-ya
      revision: main
    - name: zmk-rgbled-widget
      remote: mentako-ya
      revision: main
  self:
    path: config
```
